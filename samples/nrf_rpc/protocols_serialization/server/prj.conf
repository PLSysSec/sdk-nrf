## sample.yaml
```
sample:
  name: Protocols serialization server sample
  description: Demonstrates serialization of Bluetooth LE and OpenThread API using
    nRF RPC

common:
  sysbuild: true
  build_only: true
  platform_allow:
    - nrf52840dk/nrf52840
    - nrf54l15dk/nrf54l15/cpuapp
    - nrf54lm20dk/nrf54lm20a/cpuapp
    - native_sim
  integration_platforms:
    - nrf52840dk/nrf52840
    - nrf54l15dk/nrf54l15/cpuapp
    - nrf54lm20dk/nrf54lm20a/cpuapp
  tags:
    - ci_build
    - ci_samples_nrf_rpc

tests:
  sample.nrf_rpc.protocols_serialization.server.rpc_ble:
    extra_args: >
      SNIPPET="ble"
  sample.nrf_rpc.protocols_serialization.server.rpc_ot:
    extra_args: >
      SNIPPET="openthread"
  sample.nrf_rpc.protocols_serialization.server.rpc:
    extra_args: >
      SNIPPET="ble;openthread;debug;coex;log_rpc"
  sample.nrf_rpc.protocols_serialization.server.rpc_ci:
    extra_args: >
      SNIPPET="ble;openthread;debug;coex;log_rpc;ci-shell"
    extra_configs:
      - CONFIG_NRF_RPC_UTILS_CRASH_GEN=y
      - CONFIG_OPENTHREAD_RPC_ERASE_SETTINGS=y
```

## prj.conf
```kconfig
# --- nRF RPC ---
CONFIG_NRF_RPC=y
CONFIG_NRF_RPC_CBOR=y
CONFIG_NRF_RPC_UART_TRANSPORT=y
CONFIG_NRF_RPC_UART_RELIABLE=y

# --- Serial support for UART transport ---
CONFIG_SERIAL=y
CONFIG_UART_INTERRUPT_DRIVEN=y

# --- Simulated UART does NOT support modem/line control ---
CONFIG_UART_LINE_CTRL=n

# --- Fix for bsim/x86 
CONFIG_NRF_RPC_CBKPROXY_OUT_SLOTS=0

# --- Optional: RPC utils if you want them ---
CONFIG_NRF_RPC_UTILS=y
CONFIG_NRF_RPC_UTILS_SERVER=y
CONFIG_NRF_RPC_UTILS_DEV_INFO=y
CONFIG_NRF_RPC_UTILS_REMOTE_SHELL=y
CONFIG_NRF_RPC_UTILS_SYSTEM_HEALTH=y

# Enable Zephyr kernel heap for native build (needed by RPC server)
CONFIG_HEAP_MEM_POOL_SIZE=4096

CONFIG_LOG_BUFFER_SIZE=21000
CONFIG_LOG_MAX_LEVEL=4
CONFIG_NRF_RPC_LOG_LEVEL_DBG=y
CONFIG_NRF_RPC_TR_LOG_LEVEL_DBG=y
CONFIG_NRF_RPC_OS_LOG_LEVEL_DBG=y
CONFIG_NRF_RPC_CBOR_LOG_LEVEL_DBG=y

CONFIG_LOG=y
CONFIG_LOG_BACKEND_UART=y
```

## overlay-bsim.conf
```kconfig
# Keep RPC
CONFIG_NRF_RPC=y
CONFIG_NRF_RPC_CBOR=y
CONFIG_NRF_RPC_UART_TRANSPORT=y
CONFIG_NRF_RPC_UART_RELIABLE=n

# Native simulation UART stack (new driver name)
CONFIG_SERIAL=y
CONFIG_UART_NATIVE_PTY=y

# IMPORTANT: stop deprecated shim
CONFIG_UART_NATIVE_POSIX=n

# Avoid unsupported features on PTY UART
CONFIG_UART_LINE_CTRL=n
CONFIG_UART_INTERRUPT_DRIVEN=y
```

## prj_native_sim.conf
```kconfig
#
# Copyright (c) 2024 Nordic Semiconductor
#
# SPDX-License-Identifier: LicenseRef-Nordic-5-Clause
#

CONFIG_HEAP_MEM_POOL_SIZE=4096

CONFIG_NRF_RPC=y
CONFIG_NRF_RPC_CBOR=y
CONFIG_NRF_RPC_ZCBOR_BACKUPS=1
CONFIG_NRF_RPC_THREAD_STACK_SIZE=4096
CONFIG_NRF_RPC_GROUP_INIT_WAIT_TIME=-1

CONFIG_SERIAL=y
CONFIG_UART_INTERRUPT_DRIVEN=y
CONFIG_NRF_RPC_UART_TRANSPORT=y
# CONFIG_NRF_RPC_IPC_SERVICE is not set
CONFIG_NRF_RPC_CBKPROXY_OUT_SLOTS=0

CONFIG_NRF_RPC_UTILS=y
CONFIG_NRF_RPC_UTILS_SERVER=y

# Enable Bluetooth stack (required for BT_RPC)
CONFIG_BT=y
CONFIG_BT_PERIPHERAL=y

# Enable Bluetooth RPC to match real hardware
CONFIG_BT_RPC=y
CONFIG_BT_RPC_HOST=y
CONFIG_BT_RPC_INITIALIZE_NRF_RPC=n

CONFIG_SHELL=y
CONFIG_SHELL_STACK_SIZE=3072
# CONFIG_SHELL_BACKEND_SERIAL is not set
# Use dummy backend to keep shell thread alive
CONFIG_SHELL_BACKEND_DUMMY=y
CONFIG_LOG=y
CONFIG_LOG_MODE_IMMEDIATE=y
CONFIG_LOG_FUNC_NAME_PREFIX_DBG=n
CONFIG_LOG_BACKEND_RTT=n
CONFIG_SHELL_LOG_BACKEND=y
CONFIG_LOG_PRINTK=y
# Enable logging from ISR context (where UART RX happens)
CONFIG_LOG_PROCESS_THREAD_STARTUP_DELAY_MS=0
CONFIG_LOG_BACKEND_SHOW_COLOR=n
CONFIG_LOG_BACKEND_FORMAT_TIMESTAMP=y

# Native sim doesn't need flash/settings for this demo
# CONFIG_SETTINGS is not set
# CONFIG_FLASH is not set
# CONFIG_FLASH_MAP is not set

CONFIG_LOG_BUFFER_SIZE=21000
CONFIG_LOG_MAX_LEVEL=4
CONFIG_NRF_RPC_LOG_LEVEL_DBG=y
CONFIG_NRF_RPC_TR_LOG_LEVEL_DBG=y
CONFIG_NRF_RPC_OS_LOG_LEVEL_DBG=y
CONFIG_NRF_RPC_CBOR_LOG_LEVEL_DBG=y

# Keep simulation alive with periodic tick
CONFIG_SYS_CLOCK_TICKS_PER_SEC=1000

CONFIG_NRF_RPC_UTILS_CLIENT=y
CONFIG_NRF_RPC_UTILS_DEV_INFO=y
CONFIG_NRF_RPC_UTILS_REMOTE_SHELL=y
CONFIG_NRF_RPC_UTILS_SYSTEM_HEALTH=y
```

## prj_native_sim_uart.conf
```kconfig
#
# Copyright (c) 2024 Nordic Semiconductor
#
# SPDX-License-Identifier: LicenseRef-Nordic-5-Clause
#

CONFIG_HEAP_MEM_POOL_SIZE=4096

CONFIG_NRF_RPC=y
CONFIG_NRF_RPC_CBOR=y
CONFIG_NRF_RPC_ZCBOR_BACKUPS=1
CONFIG_NRF_RPC_THREAD_STACK_SIZE=4096
CONFIG_NRF_RPC_GROUP_INIT_WAIT_TIME=-1

# Use UART transport for native_sim (will use native PTY UART)
CONFIG_SERIAL=y
CONFIG_UART_INTERRUPT_DRIVEN=y
CONFIG_NRF_RPC_UART_TRANSPORT=y
# CONFIG_NRF_RPC_IPC_SERVICE is not set
CONFIG_NRF_RPC_CBKPROXY_OUT_SLOTS=0

CONFIG_NRF_RPC_UTILS=y
CONFIG_NRF_RPC_UTILS_SERVER=y

CONFIG_SHELL=y
CONFIG_SHELL_STACK_SIZE=3072
CONFIG_SHELL_BACKEND_DUMMY=y
CONFIG_LOG=y
CONFIG_LOG_MODE_DEFERRED=y
CONFIG_LOG_FUNC_NAME_PREFIX_DBG=n
CONFIG_LOG_BACKEND_RTT=n
CONFIG_SHELL_LOG_BACKEND=y

# Native sim doesn't need flash/settings for this demo
# CONFIG_SETTINGS is not set
# CONFIG_FLASH is not set
# CONFIG_FLASH_MAP is not set

CONFIG_LOG_BUFFER_SIZE=21000
CONFIG_NRF_RPC_LOG_LEVEL_DBG=y
CONFIG_NRF_RPC_TR_LOG_LEVEL_DBG=y
CONFIG_NRF_RPC_OS_LOG_LEVEL_DBG=y
CONFIG_NRF_RPC_CBOR_LOG_LEVEL_DBG=y

# Enable real-time execution
CONFIG_NATIVE_SIM_SLOWDOWN_TO_REAL_TIME=y
```

## boards/native_sim.overlay
```dts
/ {
	chosen {
		nordic,rpc-uart = &uart0;
	};
};

&uart0 {
	status = "okay";
};
```

## boards/nrf52_bsim.overlay
```dts
/ {
    chosen {
        nordic,rpc-uart = &uart0;   /* Required for NRF_RPC_UART_TRANSPORT */
        zephyr,console = &uart0;    /* Optional but recommended for logging */
    };
};
```

## src/main.c
```c
/*
 * Copyright (c) 2024 Nordic Semiconductor ASA
 *
 * SPDX-License-Identifier: LicenseRef-Nordic-5-Clause
 */

#include <zephyr/drivers/gpio.h>
#include <zephyr/logging/log.h>
#include <zephyr/sys/printk.h>

#include <nrf_rpc.h>

LOG_MODULE_REGISTER(nrf_ps_server, CONFIG_NRF_PS_SERVER_LOG_LEVEL);

static void err_handler(const struct nrf_rpc_err_report *report)
{
	LOG_ERR("nRF RPC error %d ocurred. See nRF RPC logs for more details", report->code);
}

#ifdef CONFIG_NRF_PS_SERVER_RPC_ALIVE_LED
void nrf_rpc_uart_initialized_hook(const struct device *uart_dev)
{
	const struct gpio_dt_spec alive_gpio = GPIO_DT_SPEC_GET(DT_ALIAS(rpc_alive_led), gpios);
	int ret;

	__ASSERT_NO_MSG(uart_dev == DEVICE_DT_GET(DT_CHOSEN(nordic_rpc_uart)));
	ret = gpio_pin_configure_dt(&alive_gpio, GPIO_OUTPUT_ACTIVE);

	if (ret) {
		LOG_ERR("Failed to configure RPC alive GPIO: %d", ret);
	}
}

void __real_z_fatal_error(unsigned int reason, const struct arch_esf *esf);

void __wrap_z_fatal_error(unsigned int reason, const struct arch_esf *esf)
{
	const struct gpio_dt_spec alive_gpio = GPIO_DT_SPEC_GET(DT_ALIAS(rpc_alive_led), gpios);

	(void)gpio_pin_configure_dt(&alive_gpio, GPIO_OUTPUT_INACTIVE);

	__real_z_fatal_error(reason, esf);
}
#endif

int main(void)
{
	int ret;

	LOG_INF("Initializing RPC server");

	ret = nrf_rpc_init(err_handler);

	LOG_INF("nrf_rpc_init returned: %d", ret);

	if (ret != 0) {
		LOG_ERR("RPC init failed");
	}

	LOG_INF("RPC server ready");

	/* Keep simulation alive by sleeping in a loop */
	LOG_INF("Entering main loop");
	printk("*** MAIN LOOP STARTED - Device is ready ***\n");
	while (1) {
		k_sleep(K_MSEC(1000));
		printk(".");  /* Print a dot every second to show device is alive */
	}

	return 0;
}
```

## src/nrf_rpc_socket_transport.c
```c
/*
 * Copyright (c) 2024 Nordic Semiconductor ASA
 *
 * SPDX-License-Identifier: LicenseRef-Nordic-5-Clause
 */

#include <zephyr/kernel.h>
#include <zephyr/logging/log.h>
#include <nrf_rpc_tr.h>
#include <nrf_rpc_errno.h>

#include <zephyr/posix/sys/socket.h>
#include <zephyr/posix/unistd.h>
#include <zephyr/posix/fcntl.h>
#include <errno.h>
#include <string.h>

/* sockaddr_un is defined in Zephyr's net headers */
#include <zephyr/net/net_ip.h>

LOG_MODULE_REGISTER(nrf_rpc_socket, CONFIG_NRF_RPC_TR_LOG_LEVEL);

#define SOCKET_PATH "/tmp/nrf_rpc_server.sock"
#define MAX_PACKET_SIZE 1536

/* Socket transport context */
struct nrf_rpc_socket {
	int server_fd;
	int client_fd;
	nrf_rpc_tr_receive_handler_t receive_callback;
	void *callback_context;
	const struct nrf_rpc_tr *transport;
	struct k_thread rx_thread;
};

static K_THREAD_STACK_DEFINE(rx_thread_stack, 2048);

static struct nrf_rpc_socket socket_ctx = {
	.server_fd = -1,
	.client_fd = -1,
};

static void rx_thread(void *arg1, void *arg2, void *arg3)
{
	struct nrf_rpc_socket *ctx = arg1;
	uint8_t buffer[MAX_PACKET_SIZE];
	ssize_t received;

	LOG_INF("RX thread started, waiting for client connection");

	/* Accept connection */
	while (ctx->client_fd < 0) {
		ctx->client_fd = accept(ctx->server_fd, NULL, NULL);
		if (ctx->client_fd < 0) {
			k_sleep(K_MSEC(100));
		} else {
			LOG_INF("Client connected on socket");
			/* Set non-blocking */
			fcntl(ctx->client_fd, F_SETFL, O_NONBLOCK);
		}
	}

	while (true) {
		received = recv(ctx->client_fd, buffer, sizeof(buffer), 0);

		if (received > 0) {
			LOG_DBG("Received %d bytes from socket", (int)received);
			if (ctx->receive_callback) {
				ctx->receive_callback(ctx->transport, buffer, 
						      received, ctx->callback_context);
			}
		} else if (received == 0) {
			LOG_INF("Client disconnected");
			close(ctx->client_fd);
			ctx->client_fd = -1;

			/* Wait for new connection */
			while (ctx->client_fd < 0) {
				ctx->client_fd = accept(ctx->server_fd, NULL, NULL);
				if (ctx->client_fd >= 0) {
					LOG_INF("Client reconnected");
					fcntl(ctx->client_fd, F_SETFL, O_NONBLOCK);
				} else {
					k_sleep(K_MSEC(100));
				}
			}
		} else if (errno != EAGAIN && errno != EWOULDBLOCK) {
			LOG_ERR("recv error: %d", errno);
		}

		k_sleep(K_MSEC(1));
	}
}

static int init(const struct nrf_rpc_tr *transport, 
		nrf_rpc_tr_receive_handler_t callback, void *context)
{
	struct nrf_rpc_socket *ctx = transport->ctx;
	struct sockaddr_un addr;
	int ret;

	LOG_INF("Initializing nRF RPC socket transport on %s", SOCKET_PATH);

	ctx->transport = transport;
	ctx->receive_callback = callback;
	ctx->callback_context = context;

	/* Create socket */
	LOG_DBG("Calling socket(AF_UNIX=%d, SOCK_STREAM=%d, 0)", AF_UNIX, SOCK_STREAM);
	ctx->server_fd = socket(AF_UNIX, SOCK_STREAM, 0);
	LOG_DBG("socket() returned: %d, errno: %d", ctx->server_fd, errno);
	if (ctx->server_fd < 0) {
		LOG_ERR("Failed to create socket: fd=%d, errno=%d", ctx->server_fd, errno);
		return -NRF_EFAULT;
	}

	/* Remove old socket file if it exists */
	unlink(SOCKET_PATH);

	/* Bind socket */
	memset(&addr, 0, sizeof(addr));
	addr.sun_family = AF_UNIX;
	strncpy(addr.sun_path, SOCKET_PATH, sizeof(addr.sun_path) - 1);

	ret = bind(ctx->server_fd, (struct sockaddr *)&addr, sizeof(addr));
	if (ret < 0) {
		LOG_ERR("Failed to bind socket: %d", errno);
		close(ctx->server_fd);
		return -NRF_EFAULT;
	}

	/* Listen for connections */
	ret = listen(ctx->server_fd, 1);
	if (ret < 0) {
		LOG_ERR("Failed to listen: %d", errno);
		close(ctx->server_fd);
		return -NRF_EFAULT;
	}

	/* Set non-blocking for accept */
	fcntl(ctx->server_fd, F_SETFL, O_NONBLOCK);

	LOG_INF("Socket transport listening on %s", SOCKET_PATH);

	/* Start RX thread */
	k_thread_create(&ctx->rx_thread, rx_thread_stack,
			K_THREAD_STACK_SIZEOF(rx_thread_stack),
			rx_thread, ctx, NULL, NULL,
			K_PRIO_PREEMPT(7), 0, K_NO_WAIT);
	k_thread_name_set(&ctx->rx_thread, "nrf_rpc_rx");

	return 0;
}

static int socket_send(const struct nrf_rpc_tr *transport, const uint8_t *data, size_t length)
{
	struct nrf_rpc_socket *ctx = transport->ctx;
	ssize_t sent;

	if (ctx->client_fd < 0) {
		LOG_WRN("No client connected, dropping packet");
		return -NRF_EAGAIN;
	}

	sent = send(ctx->client_fd, data, length, 0);
	if (sent < 0) {
		if (errno == EAGAIN || errno == EWOULDBLOCK) {
			return -NRF_EAGAIN;
		}
		LOG_ERR("send error: %d", errno);
		return -NRF_EIO;
	}

	if (sent != length) {
		LOG_WRN("Partial send: %d/%zu", (int)sent, length);
		return -NRF_EIO;
	}

	LOG_DBG("Sent %zu bytes to socket", length);
	return 0;
}

static void *tx_buf_alloc(const struct nrf_rpc_tr *transport, size_t *size)
{
	void *data = NULL;

	data = k_malloc(*size);
	if (!data) {
		LOG_ERR("Failed to allocate TX buffer");
		k_oops();
		*size = 0;
		return NULL;
	}

	return data;
}

static void tx_buf_free(const struct nrf_rpc_tr *transport, void *buf)
{
	k_free(buf);
}

/* Transport API implementation */
const struct nrf_rpc_tr_api nrf_rpc_socket_api = {
	.init = init,
	.send = socket_send,
	.tx_buf_alloc = tx_buf_alloc,
	.tx_buf_free = tx_buf_free,
};

/* Transport instance */
const struct nrf_rpc_tr nrf_rpc_socket_transport = {
	.api = &nrf_rpc_socket_api,
	.ctx = &socket_ctx,
};

/* Make the transport globally accessible with a well-known name */
extern const struct nrf_rpc_tr *nrf_rpc_primary_transport(void);
const struct nrf_rpc_tr *nrf_rpc_primary_transport(void)
{
	return &nrf_rpc_socket_transport;
}
```
